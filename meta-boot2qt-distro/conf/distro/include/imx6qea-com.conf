## meta-boot2qt-distro/conf/distro/include/imx6qea-com.conf
```bitbake
############################################################################
##
## Copyright (C) 2019 The Qt Company Ltd.
## Contact: https://www.qt.io/licensing/
##
## This file is part of the Boot to Qt meta layer.
##
## $QT_BEGIN_LICENSE:GPL$
## Commercial License Usage
## Licensees holding valid commercial Qt licenses may use this file in
## accordance with the commercial license agreement provided with the
## Software or, alternatively, in accordance with the terms contained in
## a written agreement between you and The Qt Company. For licensing terms
## and conditions see https://www.qt.io/terms-conditions. For further
## information use the contact form at https://www.qt.io/contact-us.
##
## GNU General Public License Usage
## Alternatively, this file may be used under the terms of the GNU
## General Public License version 3 or (at your option) any later version
## approved by the KDE Free Qt Foundation. The licenses are as published by
## the Free Software Foundation and appearing in the file LICENSE.GPL3
## included in the packaging of this file. Please review the following
## information to ensure the GNU General Public License requirements will
## be met: https://www.gnu.org/licenses/gpl-3.0.html.
##
## $QT_END_LICENSE$
##
############################################################################

include conf/distro/include/fsl-imx8.inc
#include conf/distro/include/fsl.inc
#include conf/distro/include/fsl-imx-preferred-env.inc

#FSL_EULA_FILE := "${COREBASE}/../meta-fsl-bsp-release/imx/EULA.txt"

DEPLOY_CONF_NAME = "Embedded Artists iMX6 Quad COM board"

PREFERRED_PROVIDER_virtual/kernel_imx = "linux-ea"
PREFERRED_PROVIDER_virtual/bootloader_imx = "u-boot-ea"

BBMASK += "\
    meta-ea/recipes-bsp/imx-mkimage/imx-boot_0.2.bbappend \
    "

#DISTRO_FEATURES_remove = "vulkan"
#
#BBMASK += "\
#    meta-boot2qt/meta-fsl-extras/recipes/u-boot/u-boot-toradex_%.bbappend \
#    meta-freescale/recipes-graphics/drm/libdrm_%.bbappend \
#    imx/meta-bsp/recipes-browser \
#    imx/meta-sdk/recipes-fsl/fsl-rc-local \
#    imx/meta-sdk/recipes-fsl/images \
#    imx/meta-sdk/recipes-fsl/packagegroup/packagegroup-fsl-gstreamer1.0.bbappend \
#    imx/meta-sdk/recipes-fsl/packagegroup/packagegroup-fsl-tools-gpu.bbappend \
#    imx/meta-sdk/recipes-fsl/packagegroup/packagegroup-fsl-tools-testapps.bbappend \
#    imx/meta-sdk/recipes-graphics/devil \
#    imx/meta-sdk/dynamic-layers/qt5-layer \
#    "

WKS_FILE = "ea-uboot-bootpart.wks.in"
WKS_FILE_DEPENDS += "u-boot-ea"

IMAGE_BOOT_FILES = "\
    zImage \
    imx6qea*.dtb \
    "
```
